## CODE/NRF_AUDIO/boards/custom_hardware.conf
```kconfig
#
# Copyright (c) 2025 Custom Hardware Configuration
#
# SPDX-License-Identifier: LicenseRef-Nordic-5-Clause
#
# Hardware configuration for custom audio player with:
# - ST7789 LCD display over SPI1
# - MicroSD card interface over SPI1
# - PCM5102A DAC over I2S0
# - Analog button ladder on AIN0
# - Battery monitoring and charging control

###############################################################################
# Serial Communication & Debugging
###############################################################################

# UART for console and logging
CONFIG_SERIAL=y
CONFIG_UART_CONSOLE=y
CONFIG_CONSOLE=y

# RTT (Real-Time Terminal) logging
CONFIG_USE_SEGGER_RTT=y
CONFIG_RTT_CONSOLE=y
CONFIG_LOG_BACKEND_RTT=y
CONFIG_LOG=y
CONFIG_LOG_BUFFER_SIZE=4096

###############################################################################
# SPI Configuration - LCD Display & MicroSD Card
###############################################################################

# SPI1 master interface
CONFIG_SPI=y
CONFIG_SPI_NOR_FLASH_OPERATIONS=y

# ST7789 LCD Display
CONFIG_LV_USE_LABEL=y
CONFIG_LV_CONF_KCONFIG=y

# MicroSD Card Support
CONFIG_DISK_DRIVER_SDMMC=y
CONFIG_SDHC=y
CONFIG_SDHC_NRF_QUIRKS=y
CONFIG_FS_FATFS=y
CONFIG_FS_FATFS_MOUNT_POINT="/sdcard"
CONFIG_FS_FATFS_NUM_FILES=10
CONFIG_FS_FATFS_NUM_DIRS=10

###############################################################################
# I2S Audio Interface - PCM5102A DAC
###############################################################################

# I2S0 for digital audio streaming
CONFIG_I2S=y
CONFIG_I2S_NRF5340=y
CONFIG_I2S_DIRECTION_RX=n
CONFIG_I2S_DIRECTION_TX=y

# I2S PCM format settings
CONFIG_I2S_FRAME_DURATION_US=1000

###############################################################################
# ADC & Button Input
###############################################################################

# ADC for button ladder and battery monitoring
CONFIG_ADC=y
CONFIG_ADC_NRF_SAADC=y
CONFIG_ADC_NRFX_SAADC_CHANNEL_7_ENABLED=y  # AIN0 on channel 7

# Button handler with analog input support
CONFIG_MODULE_BUTTON_HANDLER=y
CONFIG_MODULE_BUTTON_HANDLER_LOG_LEVEL=3
CONFIG_BUTTON_DEBOUNCE_MS=50

# ADC sampling for analog buttons
CONFIG_ADC_ASYNC=y
CONFIG_ADC_NRF_SAADC_GAIN=1_4  # 1/4 gain for better resolution

###############################################################################
# GPIO & Interrupt Handling
###############################################################################

# General Purpose I/O
CONFIG_GPIO=y

# External interrupts for wake-up button
CONFIG_GPIO_IRQN=y

# Power management for low-power sleep states
CONFIG_PM=y
CONFIG_PM_DEVICE=y

# Battery voltage monitoring via ADC
CONFIG_ADC_NRFX_SAADC_CHANNEL_5_ENABLED=y  # AIN5 for battery sense on P0.07

# I2C disabled (not used in this design)
CONFIG_I2C=n



# Kernel configuration
CONFIG_KERNEL_SHELL=y
CONFIG_SHELL=y
CONFIG_SHELL_STACK_SIZE=4096
CONFIG_SHELL_CMD_BUFF_SIZE=128
CONFIG_SHELL_BACKEND_SERIAL=n
CONFIG_SHELL_BACKEND_RTT=y

# System/logging
CONFIG_ASSERT=y
CONFIG_ASSERT_LEVEL=2
CONFIG_LOG_MODE_IMMEDIATE=n
CONFIG_LOG_TAG_MAX_LEN=2
CONFIG_LOG_TAG_DEFAULT="--"

# Thread management
CONFIG_THREAD_RUNTIME_STATS=y
CONFIG_THREAD_MONITOR=y
CONFIG_STACK_SENTINEL=y
CONFIG_INIT_STACKS=y

# Memory settings
CONFIG_MAIN_THREAD_PRIORITY=0
CONFIG_SYSTEM_WORKQUEUE_STACK_SIZE=2048



# Disable drivers not used in this design
CONFIG_HWINFO_SHELL=n
CONFIG_CLOCK_CONTROL_NRF_SHELL=n
CONFIG_FLASH_SHELL=n
CONFIG_DEVICE_SHELL=n

# Optimization for audio processing
CONFIG_SPEED_OPTIMIZATIONS=y
CONFIG_SCHED_MULTIQ=y
CONFIG_PREEMPT_ENABLED=y

# CPU load monitoring (optional)
CONFIG_CPU_LOAD=y
CONFIG_CPU_LOAD_LOG_LEVEL_WRN=y
CONFIG_CPU_LOAD_LOG_PERIODICALLY=5000

# Stack usage monitoring
CONFIG_STACK_USAGE=y



# Suppress warnings for deprecated or experimental features
CONFIG_DEPRECATION_TEST=y
CONFIG_WARN_EXPERIMENTAL=n

# Debug symbols for better error messages
CONFIG_DEBUG=y
CONFIG_DEBUG_OPTIMIZATIONS=y
CONFIG_DISPLAY=y
CONFIG_LVGL=y
CONFIG_LV_Z_MEM_POOL_SIZE=49152
CONFIG_LV_USE_LABEL=y
```

## CODE/NRF_AUDIO/build/Kconfig/boards/Kconfig.defconfig.tmp
```kconfig
# Load Zephyr board defconfig descriptions.
osource "C:/ncs/v3.3.0/zephyr/boards/nordic/nrf5340_audio_dk/Kconfig.defconfig"
```

## CODE/NRF_AUDIO/build/Kconfig/boards/Kconfig.nrf5340_audio_dk.tmp
```kconfig
# Load board Kconfig descriptions.
osource "C:/ncs/v3.3.0/zephyr/boards/nordic/nrf5340_audio_dk/Kconfig.nrf5340_audio_dk"
```
